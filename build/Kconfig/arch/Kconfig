## build/Kconfig/arch/Kconfig
```kconfig
# Load Zephyr Arch Kconfig descriptions.
osource "/home/fyaih/programacao/projetos/zephyrproject/zephyr/arch/tricore/Kconfig"
osource "/home/fyaih/programacao/projetos/zephyrproject/zephyr/arch/hexagon/Kconfig"
osource "/home/fyaih/programacao/projetos/zephyrproject/zephyr/arch/rx/Kconfig"
osource "/home/fyaih/programacao/projetos/zephyrproject/zephyr/arch/x86/Kconfig"
osource "/home/fyaih/programacao/projetos/zephyrproject/zephyr/arch/xtensa/Kconfig"
osource "/home/fyaih/programacao/projetos/zephyrproject/zephyr/arch/sparc/Kconfig"
osource "/home/fyaih/programacao/projetos/zephyrproject/zephyr/arch/riscv/Kconfig"
osource "/home/fyaih/programacao/projetos/zephyrproject/zephyr/arch/posix/Kconfig"
osource "/home/fyaih/programacao/projetos/zephyrproject/zephyr/arch/openrisc/Kconfig"
osource "/home/fyaih/programacao/projetos/zephyrproject/zephyr/arch/mips/Kconfig"
osource "/home/fyaih/programacao/projetos/zephyrproject/zephyr/arch/arm64/Kconfig"
osource "/home/fyaih/programacao/projetos/zephyrproject/zephyr/arch/arm/Kconfig"
osource "/home/fyaih/programacao/projetos/zephyrproject/zephyr/arch/arc/Kconfig"
```

## build/Kconfig/boards/Kconfig.defconfig
```kconfig
# Load Zephyr board defconfig descriptions.
osource "/home/fyaih/programacao/projetos/zephyrproject/zephyr/boards/nxp/frdm_kl25z/Kconfig.defconfig"
```

## build/Kconfig/boards/Kconfig.frdm_kl25z
```kconfig
# Load board Kconfig descriptions.
osource "/home/fyaih/programacao/projetos/zephyrproject/zephyr/boards/nxp/frdm_kl25z/Kconfig.frdm_kl25z"
```
